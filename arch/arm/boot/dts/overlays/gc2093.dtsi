// Fragment that configures an gc2093

cam_node: gc2093@37 {
	compatible = "ovti,gc2093";
	reg = <0x37>;
	status = "okey";

	clocks = <&cam1_clk>;
	clock-names = "eclk";

	avdd-supply = <&cam1_reg>;	/* 2.8v */
	dovdd-supply = <&cam_dummy_reg>;/* 1.8v */
	dvdd-supply = <&cam_dummy_reg>;	/* 1.2v */

	rotation = <0>;
	orientation = <2>;

	port {
		cam_endpoint: endpoint {
			clock-lanes = <0>;
			data-lanes = <1 2>;
			link-frequencies =
				/bits/ 64 <390000000>;
		};
	};
};
